## D1R32/sdkconfig.defaults
```kconfig
CONFIG_LOG_DEFAULT_LEVEL_INFO=y

CONFIG_SPIFFS_USE_MAGIC=y
CONFIG_SPIFFS_USE_MAGIC_LENGTH=y
CONFIG_SPIFFS_META_LENGTH=4
CONFIG_SPIFFS_PAGE_CHECK=y
CONFIG_SPIFFS_GC_MAX_RUNS=10
CONFIG_SPIFFS_USE_MTIME=y

CONFIG_FATFS_LFN_HEAP=y
CONFIG_FATFS_MAX_LFN=255
CONFIG_FATFS_USE_FASTSEEK=y
CONFIG_FATFS_FS_LOCK=0

CONFIG_NEWLIB_TIME_SYSCALL_USE_RTC_HRT=y

CONFIG_SDMMC_USE_IDF_SDSPI=y
CONFIG_SDMMC_RUN_SDIO_CARD=y
```
